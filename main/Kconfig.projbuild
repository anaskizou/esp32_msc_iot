## main/Kconfig.projbuild
```kconfig
# put here your custom config value
menu "Wifi Configuration"
config ESP_WIFI_SSID
    string "WiFi SSID"
    default "Honor 7X"
    help
	SSID (network name) for the example to connect to.

config ESP_WIFI_PASSWORD
    string "WiFi Password"
    default "azerty123"
    help
	WiFi password (WPA or WPA2) for the example to use.
endmenu
```
